## main/Kconfig.projbuild
```kconfig
menu "RaceBox"

    menu "Rotary encoder"

        config RACEBOX_ENCODER_PIN_A
            int "Encoder phase A GPIO"
            default 4
            range 0 48
            help
                GPIO connected to the rotary encoder's A output.
                Avoid ESP32-S3 strapping pins (0, 3, 45, 46), the USB pins
                (19, 20) and the pins reserved for SPI flash / PSRAM (26-37).

        config RACEBOX_ENCODER_PIN_B
            int "Encoder phase B GPIO"
            default 5
            range 0 48
            help
                GPIO connected to the rotary encoder's B output. Same
                restrictions as phase A.

        config RACEBOX_ENCODER_PIN_BUTTON
            int "Encoder push-button GPIO"
            default 6
            range 0 48
            help
                GPIO connected to the encoder's push-button, wired to ground
                and relying on the internal pull-up. Same restrictions as
                phase A.

        config RACEBOX_ENCODER_COUNTS_PER_DETENT
            int "Quadrature counts per detent"
            default 4
            range 1 8
            help
                Most detented rotary encoders produce four quadrature counts
                per physical click. Set to 1 for a smooth (detent-less)
                encoder, or 2 for a half-step encoder.

        config RACEBOX_ENCODER_GLITCH_NS
            int "Encoder glitch filter (nanoseconds)"
            default 1000
            range 0 100000
            help
                Pulses shorter than this are rejected by the PCNT hardware
                glitch filter, which debounces the A/B lines. 0 disables it.

        config RACEBOX_BUTTON_DEBOUNCE_MS
            int "Button debounce interval (milliseconds)"
            default 25
            range 0 200
            help
                The button level must be stable for this long before a state
                change is accepted.

        config RACEBOX_BUTTON_LONG_PRESS_MS
            int "Long-press threshold (milliseconds)"
            default 600
            range 200 5000

    endmenu

    menu "Display (SPI TFT)"

        config RACEBOX_TFT_PIN_MOSI
            int "TFT MOSI GPIO"
            default 11

        config RACEBOX_TFT_PIN_MISO
            int "TFT MISO GPIO (-1 if unused)"
            default 13

        config RACEBOX_TFT_PIN_SCLK
            int "TFT SCLK GPIO"
            default 12

        config RACEBOX_TFT_PIN_CS
            int "TFT CS GPIO"
            default 10

        config RACEBOX_TFT_PIN_DC
            int "TFT DC GPIO"
            default 9

        config RACEBOX_TFT_PIN_RST
            int "TFT RESET GPIO (-1 if tied high)"
            default 8

        config RACEBOX_TFT_PIN_BACKLIGHT
            int "TFT backlight GPIO (-1 if not controllable)"
            default 7

        config RACEBOX_TFT_WIDTH
            int "Panel width in pixels"
            default 480

        config RACEBOX_TFT_HEIGHT
            int "Panel height in pixels"
            default 320

        config RACEBOX_TFT_PCLK_HZ
            int "SPI pixel clock (Hz)"
            default 40000000
            help
                Reduce this if the panel shows artefacts on long or
                poorly-terminated wiring.

        config RACEBOX_TFT_BUFFER_LINES
            int "LVGL draw buffer height in lines"
            default 40
            range 10 200
            help
                Two buffers of width x this many pixels are allocated from
                internal DMA-capable RAM. Larger values reduce flush overhead
                at the cost of RAM.

    endmenu

endmenu
```
